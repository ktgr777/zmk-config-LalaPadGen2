#include "lalapadgen2.dtsi"
#include <input/processors.dtsi>
&default_transform {
    col-offset = <6>;
};
&kscan0 {
    col-gpios
        = <&xiao_d 0 GPIO_ACTIVE_HIGH>
        , <&xiao_d 1 GPIO_ACTIVE_HIGH>
        , <&xiao_d 2 GPIO_ACTIVE_HIGH>
        , <&xiao_d 3 GPIO_ACTIVE_HIGH>
        , <&gpio0 15 GPIO_ACTIVE_HIGH>
        , <&gpio0 19 GPIO_ACTIVE_HIGH>
        ;
};
&trackpad_listener_R {
    status = "okay";
    device = <&iqs9151>;
    input-processors =
        <&trackpad_key_behaviors_R>,
        <&zip_xy_scaler 1 3>,
        <&zip_scroll_scaler 1 20>,
        <&zip_scroll_transform (INPUT_TRANSFORM_Y_INVERT | INPUT_TRANSFORM_X_INVERT)>,
        <&zip_dynamic_scroll_scaler>;
};
&trackpad_listener_L {
    status = "okay";
};
